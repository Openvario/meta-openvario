#include "openvario-common.dts"

&panel {
    compatible = "panel-lvds";
    width-mm = <154>;
    height-mm = <90>;
    data-mapping = "jeida-18";
    panel-timing {
        clock-frequency = <39000000>;
        hactive = <1024>;
        vactive = <600>;
        hsync-len = <1>;
        hfront-porch = <4>;
        hback-porch = <175>;
        vsync-len = <1>;
        vfront-porch = <2>;
        vback-porch = <24>;
    };
};

&touchscreen {
    x-size = <1024>;
    y-size = <600>;
};

&uart5_ph_pins {
	pins = "PI10", "PH7";
	function = "uart5";
};
