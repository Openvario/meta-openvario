## meta-ov/conf/machine/openvario-7-CH070-DS2.conf
```bitbake
#@TYPE: Machine
#@NAME: CubieBoard2
#@DESCRIPTION: Machine configuration for the cubieboard2, based on allwinner A20 CPU http://cubieboard.org/

require ov-cubieboard2.inc

KERNEL_DEVICETREE = "openvario-7-CH070-DS2.dtb"

SHORT_OV_MACHINE= "CH70_2"
```

## meta-ov/conf/machine/ov-cubieboard.conf
```bitbake
# Experimental machine definition for a plain Cubieboard 1 without any
# additional OpenVario hardware.

DEFAULTTUNE = "cortexa8hf-neon"

PREFERRED_VERSION_linux-mainline = "5.10%"

# use the open source "Lima" Mali GPU driver
MACHINEOVERRIDES .= ":use-mailine-graphics"

# inherit the meta-sunxi "cubieboard" machine
require conf/machine/cubieboard.conf
MACHINEOVERRIDES =. "cubieboard:"

MACHINE_FEATURES:remove = "apm"
```

## meta-ov/conf/machine/ov-cubieboard2.inc
```bitbake
# Common machine definitions for all Cubieboard2-based OpenVarios

# use the open source "Lima" Mali GPU driver
MACHINEOVERRIDES .= ":use-mailine-graphics"

# inherit the meta-sunxi "cubieboard2" machine
require conf/machine/cubieboard2.conf
MACHINEOVERRIDES =. "cubieboard2:"

MACHINE_FEATURES:remove = "apm"

IMAGE_CLASSES += "sdcard_image-openvario"
IMAGE_FSTYPES = "openvario-sdimg"
```

## meta-ov/recipes-bsp/u-boot/files/openvario_defconfig
```kconfig
CONFIG_ARM=y
CONFIG_ARCH_SUNXI=y
CONFIG_SPL=y
CONFIG_MACH_SUN7I=y
CONFIG_DRAM_CLK=480
CONFIG_MMC0_CD_PIN="PH1"
CONFIG_NR_DRAM_BANKS=1
# CONFIG_SYS_MALLOC_CLEAR_ON_INIT is not set
CONFIG_SPL_I2C_SUPPORT=y
# CONFIG_CMD_FLASH is not set
# CONFIG_SPL_DOS_PARTITION is not set
# CONFIG_SPL_EFI_PARTITION is not set
CONFIG_DEFAULT_DEVICE_TREE="openvario"

CONFIG_PREBOOT="run openvario_preboot"

# CONFIG_BOOTM_NETBSD is not set
# CONFIG_BOOTM_PLAN9 is not set
# CONFIG_BOOTM_RTEMS is not set
# CONFIG_BOOTM_VXWORKS is not set

# CONFIG_NET is not set

CONFIG_ETH_DESIGNWARE=y
CONFIG_MII=y
CONFIG_SUN7I_GMAC=y
# CONFIG_SCSI is not set
CONFIG_SYS_USB_EVENT_POLL_VIA_INT_QUEUE=y


CONFIG_USB_OHCI_HCD=y
CONFIG_USB_EHCI_HCD=y
CONFIG_USB_STORAGE=y

# CONFIG_USB_GADGET is not set

CONFIG_VIDEO_LCD_BL_PWM="PB2"
CONFIG_VIDEO_LCD_BL_PWM_ACTIVE_LOW=n
CONFIG_VIDEO=y

CONFIG_CMD_BMP=y
CONFIG_SYS_PROMPT="Openvario # "


CONFIG_AUTOBOOT_KEYED=y
CONFIG_AUTOBOOT_PROMPT="Press ov to stop, autoboot in %d seconds\n"
CONFIG_AUTOBOOT_STOP_STR="ov"

CONFIG_FIT=y

# CONFIG_SPLASH_SCREEN is not set

CONFIG_VIDEO_BMP_RLE8=y
CONFIG_BMP_16BPP=y
CONFIG_BMP_24BPP=y
CONFIG_BMP_32BPP=y

# CONFIG_BOOTM_EFI is not set
# CONFIG_CMD_BOOTEFI is not set
# CONFIG_EFI_LOADER is not set
```

## meta-ov/recipes-kernel/linux/files/defconfig
```kconfig
# CONFIG_MODULES is not set
CONFIG_NO_HZ_IDLE=y
CONFIG_HIGH_RES_TIMERS=y

# TODO: disable?
CONFIG_HIGHMEM=y
```

## openvario-ppa/conf/layer.conf
```bitbake
# We have a conf and classes directory, add to BBPATH
BBPATH .= ":${LAYERDIR}"

# We have recipes-* directories, add to BBFILES
BBFILES += "${LAYERDIR}/recipes-*/*/*.bb \
            ${LAYERDIR}/recipes-*/*/*.bbappend"

BBFILE_COLLECTIONS += "meta-openvario-apps"
BBFILE_PATTERN_meta-openvario-apps = "^${LAYERDIR}/"
BBFILE_PRIORITY_meta-openvario-apps = "30"
LAYERVERSION_meta-openvario-apps = "1"
LAYERSERIES_COMPAT_meta-openvario-apps = "honister"
```

## recipes-bsp/u-boot/files/openvario-7-PQ070/openvario_defconfig
```kconfig
CONFIG_ARM=y
CONFIG_ARCH_SUNXI=y
CONFIG_SPL_I2C_SUPPORT=y
CONFIG_MACH_SUN7I=y
CONFIG_DRAM_CLK=480
CONFIG_MMC0_CD_PIN="PH1"
CONFIG_DEFAULT_DEVICE_TREE="sun7i-a20-cubieboard2"
# CONFIG_SYS_MALLOC_CLEAR_ON_INIT is not set
CONFIG_SYS_EXTRA_OPTIONS="SUNXI_GMAC,AHCI,SATAPWR=SUNXI_GPB(8)"
CONFIG_OLD_SUNXI_KERNEL_COMPAT=y
CONFIG_SPL=y
# CONFIG_CMD_IMLS is not set
# CONFIG_CMD_FLASH is not set
# CONFIG_CMD_FPGA is not set
CONFIG_ETH_DESIGNWARE=y
CONFIG_USB_EHCI_HCD=y

CONFIG_FIT=y
CONFIG_DM_SERIAL=y
CONFIG_CMD_GPIO=y

CONFIG_VIDEO_LCD_MODE="x:1024,y:600,depth:18,pclk_khz:39000,hs:1,vs:1,le:175,ri:4,up:24,lo:2,sync:3,vmode:0"
CONFIG_VIDEO_LCD_PANEL_LVDS=y
CONFIG_VIDEO_LCD_BL_PWM="PB2"
CONFIG_VIDEO_LCD_BL_PWM_ACTIVE_LOW=n
CONFIG_VIDEO

CONFIG_AUTOBOOT_KEYED=y
CONFIG_AUTOBOOT_PROMPT="Press ov to stop, autoboot in %d seconds\n",bootdelay
CONFIG_AUTOBOOT_STOP_STR="ov"
```

## recipes-bsp/u-boot/files/openvario_defconfig
```kconfig
CONFIG_ARM=y
CONFIG_ARCH_SUNXI=y
CONFIG_SPL=y
CONFIG_MACH_SUN7I=y
CONFIG_DRAM_CLK=480
CONFIG_MMC0_CD_PIN="PH1"
CONFIG_SATAPWR="PB8"
CONFIG_AHCI=y
CONFIG_NR_DRAM_BANKS=1
# CONFIG_SYS_MALLOC_CLEAR_ON_INIT is not set
CONFIG_SPL_I2C_SUPPORT=y
# CONFIG_CMD_FLASH is not set
# CONFIG_SPL_DOS_PARTITION is not set
# CONFIG_SPL_EFI_PARTITION is not set
CONFIG_DEFAULT_DEVICE_TREE="openvario"
CONFIG_SCSI_AHCI=y

# CONFIG_BOOTM_NETBSD is not set
# CONFIG_BOOTM_PLAN9 is not set
# CONFIG_BOOTM_RTEMS is not set
# CONFIG_BOOTM_VXWORKS is not set

CONFIG_ETH_DESIGNWARE=y
CONFIG_MII=y
CONFIG_SUN7I_GMAC=y
CONFIG_SCSI=y
CONFIG_SYS_USB_EVENT_POLL_VIA_INT_QUEUE=y


CONFIG_USB_OHCI_HCD=y
CONFIG_USB_EHCI_HCD=y
CONFIG_USB_STORAGE=y

CONFIG_VIDEO_LCD_BL_PWM="PB2"
CONFIG_VIDEO_LCD_BL_PWM_ACTIVE_LOW=n
CONFIG_VIDEO=y

CONFIG_CMD_BMP=y
CONFIG_SYS_PROMPT="Openvario # "


CONFIG_AUTOBOOT_KEYED=y
CONFIG_AUTOBOOT_PROMPT="Press ov to stop, autoboot in %d seconds\n"
CONFIG_AUTOBOOT_STOP_STR="ov"

CONFIG_FIT=y
```

## recipes-bsp/u-boot/u-boot-mainline/openvario-43rgb/openvario_defconfig
```kconfig
CONFIG_SPL=y
CONFIG_SYS_EXTRA_OPTIONS="AXP209_POWER,SUNXI_GMAC,AHCI,SATAPWR=SUNXI_GPB(8),USB_EHCI"
CONFIG_FDTFILE="sun7i-a20-cubieboard2.dtb"
CONFIG_MMC0_CD_PIN="PH1"
CONFIG_ARM=y
CONFIG_ARCH_SUNXI=y
CONFIG_MACH_SUN7I=y
CONFIG_DRAM_CLK=480
CONFIG_DRAM_ZQ=127
CONFIG_DRAM_EMR1=4
CONFIG_ETH_DESIGNWARE=y
CONFIG_NETDEVICES=y
CONFIG_NET=y
CONFIG_OLD_SUNXI_KERNEL_COMPAT=y
CONFIG_FIT=y
CONFIG_VIDEO_LCD_MODE="x:480,y:272,depth:18,pclk_khz:9000,hs:2,vs:10,le:38,ri:5,up:2,lo:12,sync:3,vmode:0"
CONFIG_VIDEO
```

## recipes-bsp/u-boot/u-boot/openvario-7-PQ070/openvario_defconfig
```kconfig
CONFIG_ARM=y
CONFIG_ARCH_SUNXI=y
CONFIG_MACH_SUN7I=y
CONFIG_DRAM_CLK=480
CONFIG_MMC0_CD_PIN="PH1"
CONFIG_DEFAULT_DEVICE_TREE="sun7i-a20-cubieboard2"
CONFIG_OLD_SUNXI_KERNEL_COMPAT=y
# CONFIG_SYS_MALLOC_CLEAR_ON_INIT is not set
CONFIG_SPL=y
CONFIG_SYS_EXTRA_OPTIONS="AXP209_POWER,SUNXI_GMAC,AHCI,SATAPWR=SUNXI_GPB(8),USB_EHCI"
# CONFIG_CMD_IMLS is not set
# CONFIG_CMD_FLASH is not set
# CONFIG_CMD_FPGA is not set
CONFIG_DM_ETH=y
CONFIG_ETH_DESIGNWARE=y
CONFIG_DM_SERIAL=y
CONFIG_USB=y
CONFIG_DM_USB=y

CONFIG_FIT=y

CONFIG_VIDEO_LCD_MODE="x:1024,y:600,depth:18,pclk_khz:39000,hs:1,vs:1,le:175,ri:4,up:24,lo:2,sync:3,vmode:0"
CONFIG_VIDEO_LCD_PANEL_LVDS=y
CONFIG_VIDEO_LCD_BL_PWM="PB2"
CONFIG_VIDEO_LCD_BL_PWM_ACTIVE_LOW=n
CONFIG_VIDEO
```

## recipes-bsp/u-boot/u-boot/openvario-7lvds/openvario_defconfig
```kconfig
CONFIG_SPL=y
CONFIG_SYS_EXTRA_OPTIONS="AXP209_POWER,SUNXI_GMAC,AHCI,SATAPWR=SUNXI_GPB(8),USB_EHCI"
CONFIG_FDTFILE="sun7i-a20-cubieboard2.dtb"
CONFIG_MMC0_CD_PIN="PH1"
CONFIG_ARM=y
CONFIG_ARCH_SUNXI=y
CONFIG_MACH_SUN7I=y
CONFIG_DRAM_CLK=480
CONFIG_DRAM_ZQ=127
CONFIG_DRAM_EMR1=4
CONFIG_ETH_DESIGNWARE=y
CONFIG_NETDEVICES=y
CONFIG_NET=y
CONFIG_OLD_SUNXI_KERNEL_COMPAT=y
CONFIG_FIT=y
CONFIG_VIDEO_LCD_MODE="x:1024,y:600,depth:24,pclk_khz:39000,hs:1,vs:1,le:175,ri:4,up:24,lo:2,sync:3,vmode:0"
CONFIG_VIDEO_LCD_PANEL_LVDS=y
CONFIG_VIDEO_LCD_BL_PWM="PB2"
CONFIG_VIDEO
```

## recipes-core/images/openvario-recovery-image/openvario-recovery.its
```
/dts-v1/;
/ {
    description = "Simple image with single Linux kernel and ramdisk";
    #address-cells = <0x1>;

    images {
        kernel@1 {
            description = "Openvario Linux kernel";
            data = /incbin/("./Image");
            type = "kernel";
            arch = "arm";
            os = "linux";
            compression = "none";
            load = <0x40008000>;
            entry = <0x40008000>;
	    hash@1 {
		algo  = "md5";
	    };
	    hash@2 {
		algo = "sha1";
	    };
        };
	ramdisk@1 {
            description = "Ramdisk Image";
            data = /incbin/("./initramfs.cpio.gz");
            type = "ramdisk";
            arch = "arm";
            os = "linux";
            compression = "gzip";
            load = <0x42000000>;
            entry = <0x42000000>;
	    hash@1 {
                algo = "md5";
            };
            hash@2 {
                algo = "sha1";
            };
	};
	fdt@1 {
            description = "Flattened Device Tree blob";
            data = /incbin/("./openvario.dtb");
            type = "flat_dt";
            arch = "arm";
            compression = "none";
            hash@1 {
                algo = "crc32";
		};
	    hash@2 {
                algo = "sha1";
            };
	};

};
    configurations {
        default = "conf@1";
        conf@1 {
            description = "Boot Linux kernel and ramdisk";
            kernel = "kernel@1";
            ramdisk = "ramdisk@1";
			fdt = "fdt@1";
        };
    };
};
```

## recipes-kernel/linux/files/cubieboard2/defconfig
```kconfig
# CONFIG_MODULES is not set
CONFIG_NO_HZ_IDLE=y
CONFIG_HIGH_RES_TIMERS=y

# necessary for fw upgrade initramfs
CONFIG_BLK_DEV_INITRD=y

# TODO: disable?
CONFIG_HIGHMEM=y
```
