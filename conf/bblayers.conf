## conf/bblayers.conf
```bitbake
# LAYER_CONF_VERSION is increased each time build/conf/bblayers.conf
# changes incompatibly
LCONF_VERSION = "7"

BBPATH = "${TOPDIR}"
BBFILES ?= ""

BBLAYERS ?= " \
  ${TOPDIR}/openembedded-core/meta \
  ${TOPDIR}/meta-openembedded/meta-networking \
  ${TOPDIR}/meta-openembedded/meta-oe \
  ${TOPDIR}/meta-openembedded/meta-python \
  ${TOPDIR}/meta-sunxi \
  ${TOPDIR}/meta-ov \
  ${TOPDIR}/openvario-ppa \
  "
```

## conf/distro/ovlinux.conf
```bitbake
#require conf/distro/poky.conf

DISTRO = "ovlinux"
DISTRO_NAME = "OpenVario Linux (for OpenVario Flight Computer)"

# use DISTRO_VERSION_OVERWRITE environment to set DISTRO_VERSION. BB_ENV_EXTRAWHITE="$BB_ENV_EXTRAWHITE DISTRO_VERSION_OVERWRITE" necessary
DISTRO_VERSION = "${@os.getenv('DISTRO_VERSION_OVERWRITE') if os.getenv('DISTRO_VERSION_OVERWRITE') else time.strftime('%y%j',time.gmtime())}"
#DISTRO_VERSION = "${@time.strftime('%y%j',time.gmtime())}"
#DISTRO_VERSION = "${DATE}"

DISTRO_CODENAME = "ov-hardknott"
SDK_VENDOR = "-ovlinuxsdk"
SDK_VERSION := "${@'${DISTRO_VERSION}'.replace('snapshot-${DATE}','snapshot')}"

MAINTAINER = "Timo Bruderek <openvario@timoshome.org>"

IMAGE_NAME = "OpenVario-linux-${IMAGE_BASENAME}-glibc-ipk-${DISTRO_VERSION}-${MACHINE}"
IMAGE_NAME_LINK = "OpenVario-linux-${IMAGE_BASENAME}-glibc-ipk-current-${MACHINE}"

TARGET_VENDOR = "-ovlinux"

#LOCALCONF_VERSION = "1"

DISTRO_VERSION[vardepsexclude] = "DATE"
SDK_VERSION[vardepsexclude] = "DATE"


# Override these in poky based distros
POKY_DEFAULT_DISTRO_FEATURES = "largefile opengl ptest multiarch wayland vulkan"
POKY_DEFAULT_EXTRA_RDEPENDS = "packagegroup-core-boot"
POKY_DEFAULT_EXTRA_RRECOMMENDS = "kernel-module-af-packet"

PACKAGECONFIG_append_pn-wget = " openssl gnutls"

PREFERRED_VERSION_linux-yocto ?= "4.18%"

SDK_NAME = "${DISTRO}-${TCLIBC}-${SDK_ARCH}-${IMAGE_BASENAME}-${TUNE_PKGARCH}"
SDKPATH = "/opt/${DISTRO}/${SDK_VERSION}"

DISTRO_EXTRA_RDEPENDS += " ${POKY_DEFAULT_EXTRA_RDEPENDS}"
DISTRO_EXTRA_RRECOMMENDS += " ${POKY_DEFAULT_EXTRA_RRECOMMENDS}"

DISTRO_FEATURES ?= "${DISTRO_FEATURES_DEFAULT} ${DISTRO_FEATURES_LIBC} ${POKY_DEFAULT_DISTRO_FEATURES}"
DISTRO_FEATURES_append = " systemd"
VIRTUAL-RUNTIME_init_manager = "systemd"

# Make /var/log dir persistent on the filesystem. By default logs are located
# on in-memory /var/volatile/log dir. Helps with debugging freezes.
VOLATILE_LOG_DIR = "no"

TCLIBCAPPEND = ""

IMAGE_INSTALL_append = " connman connman-client"

DISTRO_FEED_URI ?= "https://ftp.openvario.org/feed-hardknott"
DISTRO_FEED_ARCHS ?= "all armv7vet2hf-neon ${MACHINE_ARCH}"

#
# OELAYOUT_ABI allows us to notify users when the format of TMPDIR changes in
# an incompatible way. Such changes should usually be detailed in the commit
# that breaks the format and have been previously discussed on the mailing list
# with general agreement from the core team.
#
OELAYOUT_ABI = "12"

# add poky sanity bbclass
INHERIT += "poky-sanity"

# QA check settings - a little stricter than the OE-Core defaults
WARN_TO_ERROR_QA = "already-stripped compile-host-path install-host-path \
                    installed-vs-shipped ldflags pn-overrides rpaths staticdev \
                    unknown-configure-option useless-rpaths"
WARN_QA_remove = "${WARN_TO_ERROR_QA}"
ERROR_QA_append = " ${WARN_TO_ERROR_QA}"

require conf/distro/include/no-static-libs.inc
require conf/distro/include/yocto-uninative.inc
require conf/distro/include/security_flags.inc
INHERIT += "uninative"
```

## conf/layer.conf
```bitbake
# We have a conf and classes directory, append to BBPATH
BBPATH .= ":${LAYERDIR}"

# We have a recipes directory, add to BBFILES
BBFILES += "${LAYERDIR}/recipes*/*/*.bb ${LAYERDIR}/recipes*/*/*.bbappend"

BBFILE_COLLECTIONS += "meta-openvario"
BBFILE_PATTERN_meta-openvario := "^${LAYERDIR}/"
BBFILE_PRIORITY_meta-openvario = "20"
```

## conf/local.conf
```bitbake
FEED_DEPLOYDIR_BASE_URI = "http://192.168.0.222/"

PARALLEL_MAKE = "8"

SSTATE_DUPWHITELIST += "${DEPLOY_DIR}/glibc/licenses/"

#PREFERRED_VERSION_xcsoar="6.8.ov1"
#PREFERRED_VERSION_sensord = "0.2.0"
#PREFERRED_VERSION_uboot = "mainline"

test
```

## conf/machine/include/mali-modules.inc
```bitbake
PREFERRED_PROVIDER_virtual/mesa ?= "mesa-gl"
PREFERRED_PROVIDER_virtual/libgl ?= "mesa-gl"
PREFERRED_PROVIDER_virtual/libgles1 ?= "mali-modules"
PREFERRED_PROVIDER_virtual/libgles2 ?= "mali-modules"
PREFERRED_PROVIDER_virtual/egl ?= "mali-modules"


MACHINE_ESSENTIAL_EXTRA_RRECOMMENDS += "\
 kernel-module-mali \
 kernel-module-mali-drm \
  "
```

## conf/machine/include/sun5i.inc
```bitbake
require conf/machine/include/sunxi.inc
require conf/machine/include/sunxi-mali.inc
require conf/machine/include/tune-cortexa8.inc

SOC_FAMILY = "sun5i"
```

## conf/machine/include/sun7i.inc
```bitbake
require conf/machine/include/sunxi.inc
require conf/machine/include/sunxi-mali.inc
require conf/machine/include/tune-cortexa7.inc

SOC_FAMILY = "sun7i"
```

## conf/machine/include/sunxi-mali.inc
```bitbake
PREFERRED_PROVIDER_virtual/mesa ?= "mesa-gl"
PREFERRED_PROVIDER_virtual/libgl ?= "mesa-gl"
PREFERRED_PROVIDER_virtual/libgles1 ?= "sunxi-mali"
PREFERRED_PROVIDER_virtual/libgles2 ?= "sunxi-mali"
PREFERRED_PROVIDER_virtual/egl ?= "sunxi-mali"

XSERVER += "sunxi-mali \
            sunxi-mali-dev"

MACHINE_ESSENTIAL_EXTRA_RRECOMMENDS += "\
 kernel-module-mali \
 kernel-module-mali-drm \
  "
```

## conf/machine/include/sunxi.inc
```bitbake
SOC_FAMILY ??= ""
include conf/machine/include/soc-family.inc

# Sub-architecture support
MACHINE_SOCARCH_SUFFIX ?= ""
MACHINE_SOCARCH_SUFFIX_sun4i = "-sun4i"

PREFERRED_PROVIDER_virtual/xserver = "xserver-xorg"
XSERVER = "xserver-xorg \
           xf86-video-fbturbo \
           xf86-input-evdev \
           xf86-input-mouse \
           xf86-input-keyboard"

PREFERRED_PROVIDER_virtual/kernel ?= "linux"
PREFERRED_PROVIDER_u-boot ?= "u-boot"
PREFERRED_PROVIDER_virtual/bootloader ?= "u-boot"

KERNEL_IMAGETYPE ?= "uImage"

IMAGE_CLASSES += "sdcard_image-sunxi"
IMAGE_FSTYPES += "ext3 tar.gz sunxi-sdimg"

MACHINE_EXTRA_RRECOMMENDS = "kernel-modules"

UBOOT_LOCALVERSION = "-g${@d.getVar('SRCPV', True).partition('+')[2][0:7]}"

UBOOT_ENTRYPOINT ?= "0x40008000"
UBOOT_LOADADDRESS ?= "0x400080OB00"

SERIAL_CONSOLE ?= "115200 ttyS0"
MACHINE_FEATURES ?= "alsa apm keyboard rtc serial screen usbgadget usbhost vfat"
```

## conf/machine/openvario-43rgb.conf
```bitbake
#@TYPE: Machine
#@NAME: Openvario-43rgb
#@DESCRIPTION: Machine configuration for the openvario 4,3" rgb display, based on allwinner A20 CPU http://cubieboard.org/

require conf/machine/include/sun7i.inc
#require conf/machine/include/package-versions.inc

KERNEL_DEVICETREE = "sun7i-a20-cubieboard2.dtb"
UBOOT_MACHINE = "Cubieboard2_config"
#UBOOT_MACHINE = "openvario_defconfig"
SUNXI_FEX_FILE = "sys_config/a20/cubieboard2.fex"
```

## conf/machine/openvario-57-lvds.conf
```bitbake
#@TYPE: Machine
#@NAME: CubieBoard2
#@DESCRIPTION: Machine configuration for the cubieboard2, based on allwinner A20 CPU http://cubieboard.org/

#require conf/machine/include/sunxi.inc
#require conf/machine/include/sunxi-mali.inc
require conf/machine/include/tune-cortexa7.inc

SOC_FAMILY ??= ""
include conf/machine/include/soc-family.inc

# Sub-architecture support
MACHINE_SOCARCH_SUFFIX ?= ""
MACHINE_SOCARCH_SUFFIX_sun4i = "-sun4i"

PREFERRED_PROVIDER_virtual/xserver = "xserver-xorg"
XSERVER = "xserver-xorg \
           xf86-video-fbturbo \
           xf86-input-evdev \
           xf86-input-mouse \
           xf86-input-keyboard"

PREFERRED_PROVIDER_virtual/kernel ?= "linux-mainline"
PREFERRED_PROVIDER_u-boot ?= "u-boot"
PREFERRED_PROVIDER_virtual/bootloader ?= "u-boot"

KERNEL_IMAGETYPE ?= "uImage"

IMAGE_CLASSES += "sdcard_image-openvario"
IMAGE_FSTYPES += "ext3 tar.gz openvario-sdimg"

MACHINE_EXTRA_RRECOMMENDS = "kernel-modules"

UBOOT_LOCALVERSION = "-g${@d.getVar('SRCPV', True).partition('+')[2][0:7]}"

UBOOT_ENTRYPOINT ?= "0x40008000"
UBOOT_LOADADDRESS ?= "0x400080OB00"

SPL_BINARY ?= "u-boot-sunxi-with-spl.bin"

SERIAL_CONSOLE ?= "115200 ttyS0"
MACHINE_FEATURES ?= "alsa apm keyboard rtc serial screen usbgadget usbhost vfat"

PREFERRED_PROVIDER_virtual/mesa ?= "mesa-gl"
PREFERRED_PROVIDER_virtual/libgl ?= "mesa-gl"
PREFERRED_PROVIDER_virtual/libgles1 ?= "mali-blobs-sunxi"
PREFERRED_PROVIDER_virtual/libgles2 ?= "mali-blobs-sunxi"
PREFERRED_PROVIDER_virtual/egl ?= "mali-blobs-sunxi"

XSERVER += "mali-blobs-sunxi \
            mali-blobs-sunxi-dev"

MACHINE_ESSENTIAL_EXTRA_RRECOMMENDS += "\
 kernel-module-mali \
 kernel-module-mali-drm \
  "


SOC_FAMILY = "sun7i"

KERNEL_DEVICETREE_SOURCE = "openvario-57-lvds.dts"
KERNEL_DEVICETREE = "openvario.dtb"
#KERNEL_DEVICETREE = "sun7i-a20-cubieboard2.dtb"
UBOOT_MACHINE = "openvario_defconfig"
SUNXI_FEX_FILE = "sys_config/a20/cubieboard2.fex"
```

## conf/machine/openvario-57lvds.conf
```bitbake
#@TYPE: Machine
#@NAME: Openvario-57lvds
#@DESCRIPTION: Machine configuration for the openvario 5,7" lvds, based on allwinner A20 CPU http://cubieboard.org/

require conf/machine/include/sun7i.inc
#require conf/machine/include/package-versions.inc

KERNEL_DEVICETREE = "sun7i-a20-cubieboard2.dtb"
UBOOT_MACHINE = "Cubieboard2_config"
#UBOOT_MACHINE = "openvario_defconfig"
SUNXI_FEX_FILE = "sys_config/a20/cubieboard2.fex"
```

## conf/machine/openvario-7-CH070-DS2.conf
```bitbake
#@TYPE: Machine
#@NAME: CubieBoard2
#@DESCRIPTION: Machine configuration for the cubieboard2, based on allwinner A20 CPU http://cubieboard.org/

PREFERRED_VERSION_linux-mainline ?= "5.10.%"

require conf/machine/include/sunxi.inc
#require conf/machine/include/sunxi-mali.inc
require conf/machine/include/tune-cortexa7.inc

IMAGE_CLASSES += "sdcard_image-openvario"
IMAGE_FSTYPES = "openvario-sdimg"

SOC_FAMILY = "sun7i"

KERNEL_DEVICETREE_SOURCE = "openvario-7-CH070-DS2.dts"
KERNEL_DEVICETREE = "openvario.dtb"
#KERNEL_DEVICETREE = "sun7i-a20-cubieboard2.dtb"
UBOOT_MACHINE = "openvario_defconfig"
SUNXI_FEX_FILE = "sys_config/a20/cubieboard2.fex"

PACKAGECONFIG_append_pn-mesa=" lima kmsro "

SHORT_OV_MACHINE= "CH70_2"
```

## conf/machine/openvario-7-CH070.conf
```bitbake
#@TYPE: Machine
#@NAME: Openvario-7-CH070
#@DESCRIPTION: Machine configuration for the openvario 7" CH070, based on allwinner A20 CPU http://cubieboard.org/

require conf/machine/include/sun7i.inc
#require conf/machine/include/package-versions.inc

KERNEL_DEVICETREE = "sun7i-a20-cubieboard2.dtb"
#UBOOT_MACHINE = "openvario_defconfig"
UBOOT_MACHINE = "Cubieboard2_config"
SUNXI_FEX_FILE = "sys_config/a20/cubieboard2.fex"
```

## conf/machine/openvario-7-PQ070.conf
```bitbake
#@TYPE: Machine
#@NAME: CubieBoard2
#@DESCRIPTION: Machine configuration for the cubieboard2, based on allwinner A20 CPU http://cubieboard.org/

#require conf/machine/include/sunxi.inc
#require conf/machine/include/sunxi-mali.inc
require conf/machine/include/tune-cortexa7.inc

SOC_FAMILY ??= ""
include conf/machine/include/soc-family.inc

# Sub-architecture support
MACHINE_SOCARCH_SUFFIX ?= ""
MACHINE_SOCARCH_SUFFIX_sun4i = "-sun4i"

PREFERRED_PROVIDER_virtual/xserver = "xserver-xorg"
XSERVER = "xserver-xorg \
           xf86-video-fbturbo \
           xf86-input-evdev \
           xf86-input-mouse \
           xf86-input-keyboard"

PREFERRED_PROVIDER_virtual/kernel ?= "linux-mainline"
PREFERRED_PROVIDER_u-boot ?= "u-boot"
PREFERRED_PROVIDER_virtual/bootloader ?= "u-boot"

KERNEL_IMAGETYPE ?= "uImage"

IMAGE_CLASSES += "sdcard_image-openvario"
IMAGE_FSTYPES += "ext3 tar.gz openvario-sdimg"

MACHINE_EXTRA_RRECOMMENDS = "kernel-modules"

UBOOT_LOCALVERSION = "-g${@d.getVar('SRCPV', True).partition('+')[2][0:7]}"

UBOOT_ENTRYPOINT ?= "0x40008000"
UBOOT_LOADADDRESS ?= "0x400080OB00"

SPL_BINARY ?= "u-boot-sunxi-with-spl.bin"

SERIAL_CONSOLE ?= "115200 ttyS0"
MACHINE_FEATURES ?= "alsa apm keyboard rtc serial screen usbgadget usbhost vfat"

SOC_FAMILY = "sun7i"

KERNEL_DEVICETREE_SOURCE = "openvario-7-PQ070.dts"
KERNEL_DEVICETREE = "openvario.dtb"
#KERNEL_DEVICETREE = "sun7i-a20-cubieboard2.dtb"
UBOOT_MACHINE = "openvario_defconfig"
SUNXI_FEX_FILE = "sys_config/a20/cubieboard2.fex"

PACKAGECONFIG_append_pn-mesa=" lima kmsro "

SHORT_OV_MACHINE= "PQ70"
```

## conf/machine/openvario-7lvds.conf
```bitbake
#@TYPE: Machine
#@NAME: CubieBoard2
#@DESCRIPTION: Machine configuration for the cubieboard2, based on allwinner A20 CPU http://cubieboard.org/

# Only has DVI connector for external screen
GUI_MACHINE_CLASS = "bigscreen"

require conf/machine/include/tune-cortexa7.inc
require conf/machine/include/sunxi.inc
require conf/machine/include/sunxi-mali.inc

UBOOT_MACHINE = "Cubieboard2_config"
UBOOT_ENTRYPOINT = "0x40008000"
UBOOT_LOADADDRESS = "0x40008000"

SERIAL_CONSOLE = "115200 ttyS0"

MACHINE_FEATURES = "screen apm usbgadget usbhost vfat"
```

## conf/machine/ov-cb2-7-am070-ds2.conf
```bitbake
#@TYPE: Machine
#@NAME: CubieBoard2
#@DESCRIPTION: Machine configuration for the cubieboard2, based on allwinner A20 CPU http://cubieboard.org/

require ov-cubieboard2.inc

KERNEL_DEVICETREE = "ov-cb2-7-am070-ds2.dtb"

SHORT_OV_MACHINE= "AM70_2"
```

## conf/machine/ov-cubieboard.conf
```bitbake
# Experimental machine definition for a plain Cubieboard 1 without any
# additional OpenVario hardware.

DEFAULTTUNE = "cortexa8hf-neon"

# use the open source "Lima" Mali GPU driver
MACHINEOVERRIDES .= ":use-mailine-graphics"

# inherit the meta-sunxi "cubieboard" machine
require conf/machine/cubieboard.conf
MACHINEOVERRIDES =. "cubieboard:"

MACHINE_FEATURES:remove = "apm"
```

## conf/machine/ov-cubieboard2.inc
```bitbake
# Common machine definitions for all Cubieboard2-based OpenVarios

# this value is recommended by meta-sunxi/README.md
DEFAULTTUNE = "cortexa7hf-neon-vfpv4"

PREFERRED_VERSION_linux-mainline ?= "5.10.%"

# use the open source "Lima" Mali GPU driver
MACHINEOVERRIDES .= ":use-mailine-graphics"

# inherit the meta-sunxi "cubieboard2" machine
require conf/machine/cubieboard2.conf
MACHINEOVERRIDES =. "cubieboard2:"

IMAGE_CLASSES += "sdcard_image-openvario"
IMAGE_FSTYPES = "openvario-sdimg"

KERNEL_DEVICETREE = "openvario.dtb"
UBOOT_MACHINE = "openvario_defconfig"
```
