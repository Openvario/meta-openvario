## meta-ov/conf/distro/ovlinux.conf
```bitbake
#require conf/distro/poky.conf

DISTRO = "ovlinux"
DISTRO_NAME = "OpenVario Linux (for OpenVario Flight Computer)"

# use DISTRO_VERSION_OVERWRITE environment to set DISTRO_VERSION. BB_ENV_PASSTHROUGH_ADDITIONS="$BB_ENV_PASSTHROUGH_ADDITIONS DISTRO_VERSION_OVERWRITE" necessary
DISTRO_VERSION = "${@os.getenv('DISTRO_VERSION_OVERWRITE') if os.getenv('DISTRO_VERSION_OVERWRITE') else time.strftime('%y%j',time.gmtime())}"
#DISTRO_VERSION = "${@time.strftime('%y%j',time.gmtime())}"
#DISTRO_VERSION = "${DATE}"

DISTRO_CODENAME = "ov-kirkstone"
SDK_VENDOR = "-ovlinuxsdk"
SDK_VERSION := "${@'${DISTRO_VERSION}'.replace('snapshot-${DATE}','snapshot')}"

MAINTAINER = "Timo Bruderek <openvario@timoshome.org>"

IMAGE_NAME = "OpenVario-linux-${IMAGE_BASENAME}-glibc-ipk-${DISTRO_VERSION}-${MACHINE}"
IMAGE_NAME_LINK = "OpenVario-linux-${IMAGE_BASENAME}-glibc-ipk-current-${MACHINE}"

TARGET_VENDOR = "-ovlinux"

#LOCALCONF_VERSION = "1"

DISTRO_VERSION[vardepsexclude] = "DATE"
SDK_VERSION[vardepsexclude] = "DATE"

# Override these in poky based distros
POKY_DEFAULT_DISTRO_FEATURES = "largefile opengl"
POKY_DEFAULT_EXTRA_RDEPENDS = "packagegroup-core-boot"
POKY_DEFAULT_EXTRA_RRECOMMENDS = "kernel-module-af-packet"

PACKAGECONFIG:remove:pn-glibc = "nscd"

PACKAGECONFIG:remove:pn-systemd = "binfmt hibernate idn ima kmod machined myhostname nss nss-mymachines nss-resolve quotacheck seccomp sysvinit userdb utmp xz zstd"
PACKAGECONFIG:append:pn-systemd = " cgroupv2"
RDEPENDS:systemd:remove:pn-systemd = "kmod"

PACKAGECONFIG:remove:pn-connman = "wispr"
PACKAGECONFIG:remove:pn-libarchive = "libxml2 bz2 lzo zstd"
PACKAGECONFIG:remove:pn-opkg-utils = "python"
PACKAGECONFIG:append:pn-curl = " ssl"
PACKAGECONFIG:remove:pn-curl = "gnutls libidn proxy verbose"
PACKAGECONFIG:append:pn-wpa-supplicant = " openssl"
PACKAGECONFIG:remove:pn-wpa-supplicant = "gnutls"
PACKAGECONFIG:remove:pn-bluez5 = "obex-profiles readline a2dp-profiles avrcp-profiles network-profiles hid-profiles hog-profiles deprecated"
PACKAGECONFIG:remove:pn-openssh = "rng-tools"
PACKAGECONFIG:remove:pn-gnutls = "libidn"
PACKAGECONFIG:remove:pn-glib-2.0 = "libmount"

PACKAGECONFIG:remove:pn-libsndfile1 = "alsa"
DEPENDS:remove:pn-libsndfile1 = "flac libogg libvorbis"
EXTRA_OECONF:append:pn-libsndfile1 = " --disable-external-libs"

PACKAGECONFIG:remove:pn-libxml2 = "python"
PACKAGECONFIG:remove:pn-libxml2-native = "python"

PACKAGECONFIG:remove:pn-alsa-plugins = "samplerate speexdsp"

PACKAGECONFIG:remove:pn-librsvg = "gdkpixbuf"
PACKAGECONFIG:remove:pn-librsvg-native = "gdkpixbuf"

PACKAGECONFIG:remove:pn-mesa = "virgl panfrost"
EXTRA_OEMESON:remove:pn-mesa = " -Dgles1=enabled"
EXTRA_OEMESON:append:pn-mesa = " -Dgles1=disabled"

DEPENDS:remove:pn-libpcre = "bzip2 zlib"

DEPENDS:remove:pn-gdk-pixbuf-native = "shared-mime-info"
EXTRA_OEMESON:append:pn-gdk-pixbuf-native = " -Dgio_sniffing=false"
RDEPENDS:gdk-pixbuf-native:remove:pn-gdk-pixbuf-native = "shared-mime-info-native"

# Our kernel has module support, thus we don't need kmod
RDEPENDS:packagegroup-core-base-utils:remove:pn-packagegroup-core-base-utils = "kmod"

# building nano without libmagic omits the large "magic.mgc" file
DEPENDS:remove:pn-nano = "file"

# don't enable dropbear.socket by default; it shall be enabled by the
# user explicitly
SYSTEMD_AUTO_ENABLE:pn-dropbear = "disable"

# don't install the "udev-hwdb" package which weighs 16 MB
BAD_RECOMMENDATIONS += "udev-hwdb"

PREFERRED_PROVIDER_virtual/kernel = "linux-openvario"
OLDEST_KERNEL = "5.10"

SDK_NAME = "${DISTRO}-${TCLIBC}-${SDK_ARCH}-${IMAGE_BASENAME}-${TUNE_PKGARCH}"
SDKPATH = "/opt/${DISTRO}/${SDK_VERSION}"

DISTRO_EXTRA_RDEPENDS += " ${POKY_DEFAULT_EXTRA_RDEPENDS}"
DISTRO_EXTRA_RRECOMMENDS += " ${POKY_DEFAULT_EXTRA_RRECOMMENDS}"

DISTRO_FEATURES ?= "${DISTRO_FEATURES_DEFAULT} ${DISTRO_FEATURES_LIBC} ${POKY_DEFAULT_DISTRO_FEATURES}"
DISTRO_FEATURES:append = " systemd"
DISTRO_FEATURES:remove = "acl argp pcmcia usbgadget xattr nfs zeroconf pci 3g nfc x11 gobject-introspection-data sysvinit"

VIRTUAL-RUNTIME_init_manager = "systemd"

# Make /var/log dir persistent on the filesystem. By default logs are located
# on in-memory /var/volatile/log dir. Helps with debugging freezes.
VOLATILE_LOG_DIR = "no"

TCLIBCAPPEND = ""

IMAGE_INSTALL:append = " connman connman-client"

DISTRO_FEED_URI ?= "https://ftp.openvario.org/feed-kirkstone"
DISTRO_FEED_ARCHS ?= "all armv7vet2hf-neon ${MACHINE_ARCH}"

#
# OELAYOUT_ABI allows us to notify users when the format of TMPDIR changes in
# an incompatible way. Such changes should usually be detailed in the commit
# that breaks the format and have been previously discussed on the mailing list
# with general agreement from the core team.
#
OELAYOUT_ABI = "12"

# QA check settings - a little stricter than the OE-Core defaults
WARN_TO_ERROR_QA = "already-stripped compile-host-path install-host-path \
                    installed-vs-shipped ldflags pn-overrides rpaths staticdev \
                    unknown-configure-option useless-rpaths"
WARN_QA:remove = "${WARN_TO_ERROR_QA}"
ERROR_QA:append = " ${WARN_TO_ERROR_QA}"

require conf/distro/include/no-static-libs.inc
require conf/distro/include/yocto-uninative.inc
require conf/distro/include/security_flags.inc
INHERIT += "uninative"
```

## meta-ov/conf/layer.conf
```bitbake
# We have a conf and classes directory, add to BBPATH
BBPATH .= ":${LAYERDIR}"

# We have recipes-* directories, add to BBFILES
BBFILES += "${LAYERDIR}/recipes-*/*/*.bb \
            ${LAYERDIR}/recipes-*/*/*.bbappend"

BBFILE_COLLECTIONS += "meta-openvario"
BBFILE_PATTERN_meta-openvario = "^${LAYERDIR}/"
BBFILE_PRIORITY_meta-openvario = "20"
LAYERVERSION_meta-openvario = "5"
LAYERSERIES_COMPAT_meta-openvario = "kirkstone"
```

## meta-ov/conf/machine/openvario-43-rgb.conf
```bitbake
#@TYPE: Machine
#@NAME: CubieBoard2
#@DESCRIPTION: Machine configuration for the cubieboard2, based on allwinner A20 CPU http://cubieboard.org/

require ov-cubieboard2.inc

KERNEL_DEVICETREE = "openvario-43-rgb.dtb"

SHORT_OV_MACHINE= "AM43"
```

## meta-ov/conf/machine/openvario-57-lvds.conf
```bitbake
#@TYPE: Machine
#@NAME: CubieBoard2
#@DESCRIPTION: Machine configuration for the cubieboard2, based on allwinner A20 CPU http://cubieboard.org/

require ov-cubieboard2.inc

KERNEL_DEVICETREE = "openvario-57-lvds.dtb"

SHORT_OV_MACHINE= "CH57"
```

## meta-ov/conf/machine/openvario-7-AM070-DS2.conf
```bitbake
#@TYPE: Machine
#@NAME: CubieBoard2
#@DESCRIPTION: Machine configuration for the cubieboard2, based on allwinner A20 CPU http://cubieboard.org/

require ov-cubieboard2.inc

KERNEL_DEVICETREE = "openvario-7-AM070-DS2.dtb"

SHORT_OV_MACHINE= "AM70_2"
```
