#include "openvario-common.dts"

// panel for 43-rgb is probably not LVDS.
// TODO: find out device tree binding for it

// &panel {
//     compatible = "panel-lvds";
//     width-mm = <117>;
//     height-mm = <89>;
//     data-mapping = "jeida-18";
//     panel-timing {
//         /* 640x480 @60Hz */
//         clock-frequency = <25000000>;
//         hactive = <640>;
//         vactive = <480>;
//         hsync-len = <1>;
//         hfront-porch = <2>;
//         hback-porch = <157>;
//         vsync-len = <1>;
//         vfront-porch = <2>;
//         vback-porch = <42>;
//     };
// };

&uart5_ph_pins {
	pins = "PI10", "PI11";
	function = "uart5";
};
