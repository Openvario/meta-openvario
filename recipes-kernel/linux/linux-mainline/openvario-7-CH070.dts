#include "openvario-common.dts"

&panel {
    compatible = "panel-lvds";
    width-mm = <117>;
    height-mm = <89>;
    data-mapping = "jeida-18";
    panel-timing {
        clock-frequency = <39000000>;
        hactive = <1024>;
        vactive = <600>;
        hsync-len = <1>;
        hfront-porch = <4>;
        hback-porch = <175>;
        vsync-len = <1>;
        vfront-porch = <2>;
        vback-porch = <24>;
    };
};
